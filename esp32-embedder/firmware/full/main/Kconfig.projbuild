## esp32-embedder/firmware/full/main/Kconfig.projbuild
```kconfig
menu "Kata"

config KATA_OTA_FAIL_SELFTEST
    bool "TEST ONLY: fail the health check, to check rollback"
    default n
    help
        An image built with this reports its self-test as failed, so after an update through Fleet
        the bootloader goes back to the previous image, which reports "rolled back". The self-test
        itself still runs, so the log shows the real result too. Never publish one for real use, and
        never promote one to prod. CI never sets it (sdkconfig.defaults).

config KATA_SPIKE_SQS_ONLY
    bool "SPIKE (CHATS-13): no MQTT; commands from SQS, status and responses by HTTPS publish"
    default n
    help
        CHATS-13's spike. The board never opens MQTT: Fleet's commands reach it through an IoT rule
        into a per-board SQS queue (<thing>-commands-spike, beside the ingest queue), read in each
        SQS phase; responses and the status heartbeat go into an outbox, published over HTTPS
        (SigV4, service iotdata) after the phase. Sandbox only, never published.

endmenu
```

## esp32-embedder/firmware/wroom-bench/sdkconfig.defaults
```kconfig
CONFIG_IDF_TARGET="esp32"
CONFIG_ESPTOOLPY_FLASHSIZE_4MB=y
CONFIG_ESP_DEFAULT_CPU_FREQ_MHZ_240=y
CONFIG_ESP_TASK_WDT_EN=n
CONFIG_COMPILER_OPTIMIZATION_PERF=y
```
